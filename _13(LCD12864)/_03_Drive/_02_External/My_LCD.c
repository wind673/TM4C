/*******************************(C) COPYRIGHT 2016 WindRises（谢玉伸）*********************************/

/**============================================================================
* @FileName    : My_LCD.c
* @Description : LCD12864自用显示程序
* @Date        : 2016/2/28
* @By          : WindRises（谢玉伸）
* @Email       : 1659567673@ qq.com
* @Platform    : Keil uVision5(TM4C123GH6PZ)
* @Explain     : None
*=============================================================================*/

/* 头文件包含 -----------------------------------------------------------------*/ 
#include "My_LCD.h"
#include "My_LCD12864.h"
#include "math.h"

/* 私有宏定义 -----------------------------------------------------------------*/

/* 私有变量定义 ---------------------------------------------------------------*/

/* 私有（静态）函数声明 --------------------------------------------------------*/

/* 全局变量定义 ---------------------------------------------------------------*/

/* 私有（静态）函数编写 --------------------------------------------------------*/

/* 全局函数编写 ---------------------------------------------------------------*/

/**----------------------------------------------------------------------------
* @FunctionName  : LCD_Decimal()     
* @Description   : LCD显示小数 
* @Programer     : WindRises（谢玉伸）
* @Data          : 2016/2/28
* @Explain       : _x,_y:坐标   
*				   _float_num：数值    
*				   _valid：保留小数后面的位数（向后溢出） MAX = 10
------------------------------------------------------------------------------*/
void LCD_Decimal(u8 _x,u8 _y,double _float_num,u8 _valid)
{
	u8 _ch[20] = {0},_numstr[20] = {0};
	u32 _integer,_decimal; 
	char _bit = 0,_n = 0;
	_integer = (u32) _float_num; //得出整数部分
	_float_num = _float_num - _integer; //去掉整数部分得小数部分
	
	if(_valid == 0) _decimal = (u32) (_float_num*pow(10,10)); //完整显示小数部分 
	else _decimal = (u32) (_float_num*pow(10,_valid));  //保留指定的小数部分
   
	  
	
	while(_decimal) {_ch[_bit++] = '0'+_decimal%10;_decimal/=10;}; //向字符串存入小数
	_ch[_bit++] = '.';//显示小数点
	while(_integer) {_ch[_bit++] = '0'+_integer%10;_integer/=10;}; //向字符串存入整数数
	while(_bit) _numstr[_n++] = _ch[--_bit];//将字符串前后对调，回复顺序
	
	Display_Str(_y,_x,_numstr); 
	
}

/**----------------------------------------------------------------------------
* @FunctionName  : LCD_Num()     
* @Description   : LCD显示整数 
* @Programer     : WindRises（谢玉伸）
* @Data          : 2016/2/28
* @Explain       : _x,_y:坐标   
*				   _num :数值    
*				   _size:数值总长度（向后溢出，向前预留空位） 
------------------------------------------------------------------------------*/
void LCD_Num(u8 _x,u8 _y,u32 _num,u8 _size)
{
	LCD_DisplayNum(_y,_x,_num,_size);
	
}   
             
/**----------------------------------------------------------------------------
* @FunctionName  : LCD_String()     
* @Description   : LCD显示字符串 
* @Programer     : WindRises（谢玉伸）
* @Data          : 2016/2/28
* @Explain       : _x,_y:坐标   
*				   _str :字符串    
------------------------------------------------------------------------------*/
void LCD_String(u8 _x,u8 _y,u8 *_str)
{                 
	Display_Str(_y,_x,_str);
}              
              
         
/*******************************(C) COPYRIGHT 2016 WindRises（谢玉伸）*********************************/





